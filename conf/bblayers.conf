## conf/bblayers.conf
```bitbake
# LAYER_CONF_VERSION is increased each time build/conf/bblayers.conf
# changes incompatibly
LCONF_VERSION = "6"

BBPATH = "${TOPDIR}"
BBFILES ?= ""

BBLAYERS ?= " \
  REPLACE/tmp/poky/meta \
  REPLACE/tmp/poky/meta-yocto \
  REPLACE/tmp/poky/meta-yocto-bsp \
  REPLACE/tmp/poky/meta-boz \
  "
BBLAYERS_NON_REMOVABLE ?= " \
  REPLACE/tmp/poky/meta \
  REPLACE/tmp/poky/meta-yocto \
  REPLACE/tmp/poky/meta-boz \
  "
```
